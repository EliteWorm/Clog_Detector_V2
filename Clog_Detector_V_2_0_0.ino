//Clog Detector by Elite Worm (YouTube.com/c/EliteWorm)
//Version 2.0.0

//WARNING: 
//You MUST burn a specific bootloader BEFORE uploading this program. Watch the video of the project for more information.
//You MUST connect P0 to GND in order to upload this program. A simple wire will work.

#include <TinyWireM.h>
#include <TinyOzOLED.h>

const unsigned char clogged_bmp [] PROGMEM = {
	0x00, 0x00, 0x00, 0x00, 0x00, 0x00, 0x00, 0x00, 0x00, 0x00, 0x00, 0x00, 0x00, 0x00, 0x00, 0x00, 
	0x00, 0x00, 0x00, 0x00, 0x00, 0x00, 0x00, 0x00, 0x00, 0x00, 0x00, 0x00, 0x00, 0x00, 0x00, 0x00, 
	0x00, 0x00, 0x00, 0x00, 0x00, 0x00, 0x00, 0x00, 0x00, 0x00, 0x00, 0x00, 0x00, 0x00, 0x00, 0x00, 
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	0x00, 0x00, 0x00, 0x00, 0x00, 0x00, 0x00, 0x00, 0x00, 0x00, 0x00, 0x00, 0x00, 0x00, 0x00, 0x00
};

const unsigned char off_bmp [] PROGMEM = {
	0x00, 0x00, 0x00, 0x00, 0x00, 0x00, 0x00, 0x00, 0x00, 0x00, 0x00, 0x00, 0x00, 0x00, 0x00, 0x00, 
	0x00, 0x00, 0x00, 0x00, 0x00, 0x00, 0x00, 0x00, 0x00, 0x00, 0x00, 0x00, 0x00, 0x00, 0x00, 0x00, 
	0x00, 0x00, 0x00, 0x00, 0x00, 0x00, 0x00, 0x00, 0x00, 0x00, 0x00, 0x00, 0x00, 0x00, 0x00, 0x00, 
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	0x00, 0x00, 0x00, 0x00, 0x00, 0x00, 0x00, 0x00, 0x00, 0x00, 0x00, 0x00, 0x00, 0x00, 0x00, 0x00
};

const unsigned char on_bmp [] PROGMEM = {
	0x00, 0x00, 0x00, 0x00, 0x00, 0x00, 0x00, 0x00, 0x00, 0x00, 0x00, 0x00, 0x00, 0x00, 0x00, 0x00, 
	0x00, 0x00, 0x00, 0x00, 0x00, 0x00, 0x00, 0x00, 0x00, 0x00, 0x00, 0x00, 0x00, 0x00, 0x00, 0x00, 
	0x00, 0x00, 0x00, 0x00, 0x00, 0x00, 0x00, 0x00, 0x00, 0x00, 0x00, 0x00, 0x00, 0x00, 0x00, 0x00, 
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	0x00, 0x00, 0x00, 0x00, 0x00, 0x00, 0x00, 0x00, 0x00, 0x00, 0x00, 0x00, 0x00, 0x00, 0x00, 0x00
};

bool printstarted = true;
bool clog = false;
byte program_step = 1;
unsigned long previousmillis = 0;
bool currentLDRstate = 0;
bool previousLDRstate = 0;
byte i = 0;

void setup() {
  
  pinMode(A0, INPUT_PULLUP); //PUSH BUTTON
  pinMode(1, INPUT); //LDR
  pinMode(3, OUTPUT); //BUZZER
  pinMode(4, OUTPUT); //OUT
  
  digitalWrite(3, LOW);
  
  OzOled.init();
  OzOled.clearDisplay();
  OzOled.setNormalDisplay();
  OzOled.setBrightness(255);  
  OzOled.sendCommand(0xA8);
  OzOled.sendCommand(0x1F);
  OzOled.sendCommand(0xDA);
  OzOled.sendCommand(0x02);  
  OzOled.printString(" ELITE WORM",2,0);
  OzOled.printString("   V2.0.0",2,3);
  delay(3000);
  
  previousLDRstate = digitalRead(1);
  
}

void loop() {
  
  currentLDRstate = digitalRead(1);
  
  if((analogRead(A0) < 940) && (!printstarted)) {
    
    printstarted = true;
    previousLDRstate = currentLDRstate;
    program_step = 1;
    digitalWrite(3, HIGH);
    delay(50);
    digitalWrite(3, LOW);
    
  }
  
  if(printstarted) printing();
  
  if(clog) clogged();
  
}

void printing() {
    
  switch(program_step) {
  
      case 0:
        
        OzOled.drawBitmap(off_bmp,0,0,16,4);
        printstarted = false;
        i = 0;
        delay(300);
      
      break;
    
      case 1:
        
        OzOled.drawBitmap(on_bmp,0,0,16,4);
        previousmillis = millis();
        program_step++;
        delay(300);
   
      break;
      
      case 2:
      
        if((millis() - previousmillis) >= 420000) program_step = 3;
        
        if(currentLDRstate != previousLDRstate) {
          
          previousmillis = millis();
          previousLDRstate = currentLDRstate;
          OzOled.clearDisplay();
          OzOled.drawBitmap(on_bmp,0,0,16,4);
          
        }
          
        if(analogRead(A0) < 940) {
          
          program_step = 0;
          digitalWrite(3, HIGH);
          delay(50);
          digitalWrite(3, LOW);
          delay(50);
          digitalWrite(3, HIGH);
          delay(50);
          digitalWrite(3, LOW);
          
        }
      
      break;
      
      case 3:
      
        clog = true;
        digitalWrite(4, HIGH);
        OzOled.drawBitmap(clogged_bmp,0,0,16,4);
        program_step++;
        
      break;
      
      case 4:
      
        if(analogRead(A0) < 940) {
          
          program_step = 0;
          clog = false;
          digitalWrite(3, LOW);
          digitalWrite(4, LOW);
      
        }      
      
      break;
  
  }
  
}

void clogged() {
  
  if(((millis() - previousmillis) >= 500) && (i < 120)) {
  
    digitalWrite((3), !digitalRead(3));
    previousmillis = millis();
    i++;
    
  }  
  
}
